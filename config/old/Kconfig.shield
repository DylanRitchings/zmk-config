## config/old/Kconfig.shield
```kconfig
if SHIELD_HELIX_RIGHT

config ZMK_KEYBOARD_NAME
    default "Helix"

config ZMK_SPLIT_BLE_ROLE_CENTRAL
    default y

endif

if SHIELD_HELIX_LEFT || SHIELD_HELIX_RIGHT

config ZMK_SPLIT
    default y

endif
```
